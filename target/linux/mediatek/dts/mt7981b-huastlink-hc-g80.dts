// SPDX-License-Identifier: GPL-2.0-or-later OR MIT

/dts-v1/;

#include "mt7981b-huastlink-hc-g80.dtsi"

/ {
	model = "HUASTLINK HC-G80 MAXIS";
	compatible = "huastlink,hc-g80", "mediatek,mt7981b";
};

// SPDX-License-Identifier: GPL-2.0-or-later OR MIT

/dts-v1/;
#include "mt7981b-huastlink-hc-g60.dtsi"

/ {
	model = "Huastlink HC-G60";
	compatible = "huastlink,hc-g60", "mediatek,mt7981b";

	chosen {
		bootargs-override = "console=ttyS0,115200n8";
		stdout-path = "serial0:115200n8";
	};
};
